/* Copyright (c) 2013, The Linux Foundation. All rights reserved.
 *
 * This program is free software; you can redistribute it and/or modify
 * it under the terms of the GNU General Public License version 2 and
 * only version 2 as published by the Free Software Foundation.
 *
 * This program is distributed in the hope that it will be useful,
 * but WITHOUT ANY WARRANTY; without even the implied warranty of
 * MERCHANTABILITY or FITNESS FOR A PARTICULAR PURPOSE.  See the
 * GNU General Public License for more details.
 */


/dts-v1/;
/include/ "msm8926.dtsi"
/include/ "msm8226-8926ss_pdp2.dtsi"
/include/ "arima_8926ss_pdp2.dtsi"
// [All][Main][Camera][DMS][32704] Rebase: Camera rebase on PDP2 S
///include/ "msm8226-camera-sensor-mtp.dtsi"
/include/ "msm8226-camera-sensor-8926_pdp2.dtsi"
//[All][Main][Camera][DMS][32704] Rebase: Camera rebase on PDP2 E
/ {
	model = "Qualcomm MSM 8926 MTP (Arima 8926SS PDP2)";
	compatible = "qcom,msm8926-mtp", "qcom,msm8926", "qcom,mtp";
	qcom,board-id = <8 0>;
};
